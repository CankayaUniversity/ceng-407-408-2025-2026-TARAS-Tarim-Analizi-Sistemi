## Donanim/esp-idf/aht25_test/main/Kconfig.projbuild
```kconfig
menu "AHT25 Configuration"

    config AHT25_I2C_SDA
        int "SDA GPIO Num"
        default 2 if IDF_TARGET_ESP32C6
        default 5
        help
            GPIO number for I2C SDA.

    config AHT25_I2C_SCL
        int "SCL GPIO Num"
        default 3 if IDF_TARGET_ESP32C6
        default 4
        help
            GPIO number for I2C SCL.

endmenu
```

## Donanim/esp-idf/aht25_wifi/main/Kconfig.projbuild
```kconfig
menu "AHT25 WiFi Configuration"

    config AHT25_I2C_SDA
        int "SDA GPIO Num"
        default 2 if IDF_TARGET_ESP32C6
        default 5
        help
            GPIO number for I2C SDA.

    config AHT25_I2C_SCL
        int "SCL GPIO Num"
        default 3 if IDF_TARGET_ESP32C6
        default 4
        help
            GPIO number for I2C SCL.

    config WIFI_SSID
        string "WiFi SSID"
        default ""
        help
            WiFi network name to connect to.

    config WIFI_PASSWORD
        string "WiFi Password"
        default ""
        help
            WiFi network password.

    config BACKEND_URL
        string "Backend URL"
        default "http://16.171.19.61:3000/api/sensors/device/data"
        help
            HTTP endpoint to POST sensor data to.

    config DEVICE_API_KEY
        string "Device API Key"
        default ""
        help
            API key sent in X-Device-Key header for authentication.

    config POST_INTERVAL_SEC
        int "POST interval (seconds)"
        default 300
        range 10 3600
        help
            How often to send data to backend (default 300 = 5 minutes).

endmenu
```
